## config/shields/dactyl_ace/Kconfig.defconfig
```kconfig
if SHIELD_DACTYL_ACE_LEFT

    config ZMK_KEYBOARD_NAME
        default "Dactyl Ace"
    
    config ZMK_SPLIT_ROLE_CENTRAL
        default y

endif

if SHIELD_DACTYL_ACE_RIGHT

    config ZMK_KEYBOARD_NAME
        default "Dactyl Ace Right"

endif

if SHIELD_DACTYL_ACE_LEFT || SHIELD_DACTYL_ACE_RIGHT

    config ZMK_SPLIT
        default y

endif
```

## config/shields/dactyl_ace/Kconfig.shield
```kconfig
//config SHIELD_DACTYLACE
//    def_bool $(shields_list_contains, DactylAce)


config SHIELD_DACTYL_ACE_LEFT
    def_bool $(shields_list_contains,dactyl_ace_left)

// config SHIELD_DACTYL_ACE_RIGHT
//    def_bool $(shields_list_contains,dactyl_ace_right)
```
