/ {
        chosen {
                zmk,kscan = &default_kscan;
        };

        default_kscan: kscan {
                compatible = "zmk,kscan-gpio-direct";
                lable = "default_kscan";
                diode-direction = "col2row";

                row-gpios = <&gpio0 29 (GPIO_ACTIVE_HIGH | GPIO_PULL_DOWN)>, // row 1
                            <&gpio0 2 (GPIO_ACTIVE_HIGH | GPIO_PULL_DOWN)>, // row 2
                            <&gpio1 15 (GPIO_ACTIVE_HIGH | GPIO_PULL_DOWN)>, // row 3
                            <&gpio1 13 (GPIO_ACTIVE_HIGH | GPIO_PULL_DOWN)>, // row 4
                            <&gpio1 11 (GPIO_ACTIVE_HIGH | GPIO_PULL_DOWN)>, // row 5
                            <&gpio0 10 (GPIO_ACTIVE_HIGH | GPIO_PULL_DOWN)>; // row 6
                        
                col-gpios = <&gpio0 20 GPIO_ACTIVE_HIGH>, // col 1
                            <&gpio0 22 GPIO_ACTIVE_HIGH>, // col 2
                            <&gpio0 24 GPIO_ACTIVE_HIGH>, // col 3
                            <&gpio1 0 GPIO_ACTIVE_HIGH>, // col 4
                            <&gpio0 11 GPIO_ACTIVE_HIGH>, // col 5
                            <&gpio1 4 GPIO_ACTIVE_HIGH>; // col 6
        };
};